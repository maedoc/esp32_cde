## Kconfig.projbuild
```kconfig
menu "ESP32 CDE Configuration"

    config CDE_MAX_FEATURES
        int "Maximum number of features for CDE"
        range 1 256
        default 32
        help
            Maximum number of features that can be used in conditional density estimation.

    config CDE_SAMPLE_BUFFER_SIZE
        int "Sample buffer size"
        range 64 4096
        default 256
        help
            Size of the circular buffer for storing samples.

    config CDE_USE_FLOAT_PRECISION
        bool "Use single precision floating point"
        default y
        help
            Use single precision (float) instead of double precision for calculations.

endmenu
```

## components/can_nvs/test/sdkconfig.defaults
```kconfig
# Enable Unity test framework
CONFIG_UNITY_ENABLE_FLOAT=y
CONFIG_UNITY_ENABLE_DOUBLE=y

# NVS settings
CONFIG_NVS_ENCRYPTION=n

# Increase main task stack size for tests
CONFIG_ESP_MAIN_TASK_STACK_SIZE=8192
```

## sdkconfig.defaults
```kconfig
# ESP32 CDE Configuration
CONFIG_ESPTOOLPY_FLASHSIZE_4MB=y
CONFIG_PARTITION_TABLE_SINGLE_APP=y
CONFIG_FREERTOS_HZ=1000

# CDE specific configuration
CONFIG_CDE_MAX_FEATURES=32
CONFIG_CDE_SAMPLE_BUFFER_SIZE=256
CONFIG_CDE_USE_FLOAT_PRECISION=y

# Logging configuration
CONFIG_LOG_DEFAULT_LEVEL_INFO=y
CONFIG_LOG_DEFAULT_LEVEL=3

# Memory configuration
CONFIG_ESP_MAIN_TASK_STACK_SIZE=8192
```
